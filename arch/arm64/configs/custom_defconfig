## arch/arm64/configs/custom_defconfig
```kconfig
# kexec system call
# CONFIG_KEXEC=y

# JOP Attack Prevention
# CONFIG_RKP_CFP_JOPP=y

# bcmdhd Monitor Mode
CONFIG_WL_MONITOR=y

# bcrcmfmac WiFi Driver
CONFIG_BRCMFMAC=m
CONFIG_BRCMFMAC_SDIO=y
CONFIG_BRCMFMAC_USB=y
CONFIG_BRCMFMAC_PCIE=y
CONFIG_BRCMDBG=y

# Kernel debugging
# CONFIG_DEBUG_KERNEL=y

# SELinux boot parameter
# CONFIG_SECURITY_SELINUX_BOOTPARAM=y

# Cryptographic API
# CONFIG_CRYPTO_CHACHA20=y
# CONFIG_CRYPTO_CHACHA20POLY1305=y
# CONFIG_CRYPTO_AES_ARM64_CE_CCM
# CONFIG_CRYPTO_AES_ARM64_NEON_BLK=y
```
